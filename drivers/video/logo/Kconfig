## drivers/video/logo/Kconfig
```kconfig
# SPDX-License-Identifier: GPL-2.0-only
#
# Logo configuration
#

menuconfig LOGO
	bool "Bootup logo"
	depends on FB_CORE || SGI_NEWPORT_CONSOLE
	help
	  Enable and select frame buffer bootup logos.

if LOGO

config FB_LOGO_EXTRA
	bool "Show an extra logo at bootup"
	depends on FB
	default y if SPU_BASE

config LOGO_CUSTOM
	bool "Custom boot logo"
	default n
	help
	  Enable this to use a custom 224-color Linux logo. This will disable the standard 224-color Linux logo.

if !LOGO_CUSTOM
config LOGO_LINUX_MONO
	bool "Standard black and white Linux logo"
	default y

config LOGO_LINUX_VGA16
	bool "Standard 16-color Linux logo"
	default y

config LOGO_LINUX_CLUT224
	bool "Standard 224-color Linux logo"
	default y

config LOGO_DEC_CLUT224
	bool "224-color Digital Equipment Corporation Linux logo"
	depends on MACH_DECSTATION || ALPHA
	default y

config LOGO_MAC_CLUT224
	bool "224-color Macintosh Linux logo"
	depends on MAC
	default y

config LOGO_PARISC_CLUT224
	bool "224-color PA-RISC Linux logo"
	depends on PARISC
	default y

config LOGO_SGI_CLUT224
	bool "224-color SGI Linux logo"
	depends on SGI_IP22 || SGI_IP27 || SGI_IP32
	default y

config LOGO_SUN_CLUT224
	bool "224-color Sun Linux logo"
	depends on SPARC
	default y

config LOGO_SUPERH_MONO
	bool "Black and white SuperH Linux logo"
	depends on SUPERH
	default y

config LOGO_SUPERH_VGA16
	bool "16-color SuperH Linux logo"
	depends on SUPERH
	default y

config LOGO_SUPERH_CLUT224
	bool "224-color SuperH Linux logo"
	depends on SUPERH
	default y

endif # !LOGO_CUSTOM

if LOGO_CUSTOM
config LOGO_CUSTOM_CLUT224
	bool "Custom 224-color Linux logo"
	depends on LOGO_CUSTOM
	default y
	help
	  Enable this to use a custom 224-color Linux logo. This will disable the standard 224-color Linux logo.
endif # LOGO_CUSTOM

endif # LOGO
```
